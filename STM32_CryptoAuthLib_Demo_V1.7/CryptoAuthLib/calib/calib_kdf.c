/**
 * \file
 * \brief CryptoAuthLib Basic API methods for KDF command.
 *
 * The KDF command implements one of a number of Key Derivation Functions (KDF).
 * Generally this function combines a source key with an input string and
 * creates a result key/digest/array. Three algorithms are currently supported:
 * PRF, HKDF and AES.
 *
 * \note List of devices that support this command - MOD8A/B. Refer to device
 *       datasheet for full details.
 *
 * \copyright (c) 2020-2025 ModSemi Technology Inc. and its subsidiaries.
 *
 * \page License
 *
 * Subject to your compliance with these terms, you may use ModSemi software
 * and any derivatives exclusively with ModSemi products. It is your
 * responsibility to comply with third party license terms applicable to your
 * use of third party software (including open source software) that may
 * accompany ModSemi software.
 *
 * THIS SOFTWARE IS SUPPLIED BY MODMEMI "AS IS". NO WARRANTIES, WHETHER
 * EXPRESS, IMPLIED OR STATUTORY, APPLY TO THIS SOFTWARE, INCLUDING ANY IMPLIED
 * WARRANTIES OF NON-INFRINGEMENT, MERCHANTABILITY, AND FITNESS FOR A
 * PARTICULAR PURPOSE. IN NO EVENT WILL MODMEMI BE LIABLE FOR ANY INDIRECT,
 * SPECIAL, PUNITIVE, INCIDENTAL OR CONSEQUENTIAL LOSS, DAMAGE, COST OR EXPENSE
 * OF ANY KIND WHATSOEVER RELATED TO THE SOFTWARE, HOWEVER CAUSED, EVEN IF
 * MODMEMI HAS BEEN ADVISED OF THE POSSIBILITY OR THE DAMAGES ARE
 * FORESEEABLE. TO THE FULLEST EXTENT ALLOWED BY LAW, MODMEMI'S TOTAL
 * LIABILITY ON ALL CLAIMS IN ANY WAY RELATED TO THIS SOFTWARE WILL NOT EXCEED
 * THE AMOUNT OF FEES, IF ANY, THAT YOU HAVE PAID DIRECTLY TO MODMEMI FOR
 * THIS SOFTWARE.
 */

#include "cryptoauthlib.h"

/** \brief Executes the KDF command, which derives a new key in PRF, AES, or
 *          HKDF modes.
 *
 * Generally this function combines a source key with an input string and
 * creates a result key/digest/array.
 *
 * \param[in]  device     Device context pointer
 * \param[in]  mode       Mode determines KDF algorithm (PRF,AES,HKDF), source
 *                        key location, and target key locations.
 * \param[in]  key_id     Source and target key slots if locations are in the
 *                        EEPROM. Source key slot is the LSB and target key
 *                        slot is the MSB.
 * \param[in]  details    Further information about the computation, depending
 *                        on the algorithm (4 bytes).
 * \param[in]  message    Input value from system (up to 128 bytes). Actual size
 *                        of message is 16 bytes for AES algorithm or is encoded
 *                        in the MSB of the details parameter for other
 *                        algorithms.
 * \param[out] out_data   Output of the KDF function is returned here. If the
 *                        result remains in the device, this can be NULL.
 * \param[out] out_nonce  If the output is encrypted, a 32 byte random nonce
 *                        generated by the device is returned here. If output
 *                        encryption is not used, this can be NULL.
 *
 * \return MSE_SUCCESS on success, otherwise an error code.
 */
MSE_STATUS calib_kdf(MSEDevice device, uint8_t mode, uint16_t key_id, const uint32_t details, const uint8_t* message, uint8_t* out_data, uint8_t* out_nonce)
{
    MSEPacket packet;
    MSE_STATUS status = MSE_GEN_FAIL;
    uint16_t out_data_size = 0;

    do
    {
        if ((device == NULL) || (message == NULL))
        {
            status = MSE_TRACE(MSE_BAD_PARAM, "NULL pointer received");
            break;
        }

        // Build the KDF command
        packet.param1 = mode;
        packet.param2 = key_id;

        // Add details parameter
        packet.data[0] = (uint8_t)details;
        packet.data[1] = (uint8_t)(details >> 8);
        packet.data[2] = (uint8_t)(details >> 16);
        packet.data[3] = (uint8_t)(details >> 24);

        // Add input message
        if ((mode & KDF_MODE_ALG_MASK) == KDF_MODE_ALG_AES)
        {
            // AES algorithm has a fixed message size
            memcpy(&packet.data[KDF_DETAILS_SIZE], message, AES_DATA_SIZE);
        }
        else
        {
            // All other algorithms encode message size in the last byte of details
            memcpy(&packet.data[KDF_DETAILS_SIZE], message, packet.data[3]);
        }

        // Build command
        if ((status = bpKDF(mse_get_device_type_ext(device), &packet)) != MSE_SUCCESS)
        {
            MSE_TRACE(status, "bpKDF - failed");
            break;
        }

        // Run command
        if ((status = mse_execute_command(&packet, device)) != MSE_SUCCESS)
        {
            MSE_TRACE(status, "calib_kdf - execution failed");
            break;
        }

        if (((mode & KDF_MODE_ALG_MASK) == KDF_MODE_ALG_PRF) && (details & KDF_DETAILS_PRF_TARGET_LEN_64))
        {
            out_data_size = 64;
        }
        else
        {
            out_data_size = 32;
        }

        // Return OutData if possible
        if (out_data != NULL && packet.data[MSE_COUNT_IDX] >= (MSE_PACKET_OVERHEAD + out_data_size))
        {
            memcpy(out_data, &packet.data[MSE_RSP_DATA_IDX], out_data_size);
        }

        // return OutNonce if possible
        if (out_nonce != NULL && packet.data[MSE_COUNT_IDX] >= (MSE_PACKET_OVERHEAD + out_data_size + 32))
        {
            memcpy(out_nonce, &packet.data[MSE_RSP_DATA_IDX + out_data_size], 32);
        }
    }
    while (false);

    return status;
}
